## buildroot/external/package/monitor-news2/Config.in
```kconfig
config BR2_PACKAGE_MONITOR_NEWS2
	bool "monitor-news2"
	depends on BR2_PACKAGE_QT6
	select BR2_PACKAGE_QT6BASE_GUI
	select BR2_PACKAGE_QT6BASE_TEST
	select BR2_PACKAGE_QT6DECLARATIVE
	select BR2_PACKAGE_QT6DECLARATIVE_QUICK
	help
	  Interface de beira de leito do monitor NEWS2 (Qt 6 + QML).
	  Instalada em /root/monitor-news2, sem script de init. Le o
	  MAX30102 pela /dev/i2c-1 (i2c-dev, polling da FIFO a cada 40 ms)
	  e calcula FC, SpO2 e FR pela biblioteca de ppg-pipeline/.

if BR2_PACKAGE_MONITOR_NEWS2

config BR2_PACKAGE_MONITOR_NEWS2_SRCDIR
	string "diretorio do codigo-fonte"
	default "$(BR2_EXTERNAL_NEWS2_PATH)/../../software"
	help
	  Diretorio software/ deste repositorio (SITE_METHOD=local): o app
	  fica em monitor-news2/ e usa a biblioteca de ppg-pipeline/.

endif

comment "monitor-news2 needs Qt6"
	depends on !BR2_PACKAGE_QT6
```
