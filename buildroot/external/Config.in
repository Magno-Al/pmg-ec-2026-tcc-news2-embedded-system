## buildroot/external/package/monitor-news2/Config.in
```kconfig
config BR2_PACKAGE_MONITOR_NEWS2
	bool "monitor-news2"
	depends on BR2_PACKAGE_QT6
	select BR2_PACKAGE_QT6BASE_GUI
	select BR2_PACKAGE_QT6BASE_TEST
	select BR2_PACKAGE_QT6DECLARATIVE
	select BR2_PACKAGE_QT6DECLARATIVE_QUICK
	help
	  Interface de beira de leito do monitor NEWS2 (Qt 6 + QML).
	  Instalada em /root/monitor-news2, sem script de init.

if BR2_PACKAGE_MONITOR_NEWS2

config BR2_PACKAGE_MONITOR_NEWS2_SRCDIR
	string "diretorio do codigo-fonte"
	default "$(BR2_EXTERNAL_NEWS2_PATH)/../../software"
	help
	  Diretorio software/ deste repositorio (SITE_METHOD=local): o app
	  fica em monitor-news2/ e usa a biblioteca de ppg-pipeline/.

choice
	prompt "acesso ao MAX30102"
	default BR2_PACKAGE_MONITOR_NEWS2_SENSOR_I2CDEV
	help
	  Como o app le o sensor PPG. O overlay i2c-sensor,max30102 fica
	  sempre no config.txt; sem o modulo carregado ele nao ocupa o
	  endereco 0x57, entao nao atrapalha o i2c-dev.

config BR2_PACKAGE_MONITOR_NEWS2_SENSOR_I2CDEV
	bool "i2c-dev (espaco de usuario, polling)"
	help
	  O app escreve os registradores do chip pela /dev/i2c-1 e le a
	  FIFO a cada 40 ms. Nao usa o pino INT.

config BR2_PACKAGE_MONITOR_NEWS2_SENSOR_IIO
	bool "driver IIO do kernel (interrupcao no GPIO 17)"
	select BR2_PACKAGE_KMOD
	help
	  O driver drivers/iio/health/max30102 atende a interrupcao do
	  sensor e o app le /dev/iio:deviceN. Instala o S30max30102,
	  que carrega o modulo no boot. Exige o INT no GPIO 17.

endchoice

choice
	prompt "calculo de FC/SpO2/FR"
	default BR2_PACKAGE_MONITOR_NEWS2_PPG_HYBRID
	help
	  Quem calcula os sinais vitais a partir do PPG. Comparacao dos
	  metodos: software/ppg-pipeline/scripts/comparison.

config BR2_PACKAGE_MONITOR_NEWS2_PPG_HYBRID
	bool "hibrido (FC/SpO2 do ppg-pipeline, FR do PpgProcessor)"

config BR2_PACKAGE_MONITOR_NEWS2_PPG_PIPELINE
	bool "ppg-pipeline (MSPTD + Smart Fusion)"

config BR2_PACKAGE_MONITOR_NEWS2_PPG_PROCESSOR
	bool "PpgProcessor do app"

config BR2_PACKAGE_MONITOR_NEWS2_PPG_REFINED
	bool "PpgProcessor + FC refinada a 100 Hz pelo ppg-pipeline"
	depends on BR2_PACKAGE_MONITOR_NEWS2_SENSOR_IIO
	help
	  SpO2 e FR do PpgProcessor; a FC passa a vir do ppg-pipeline
	  (MSPTD) sobre as amostras de 100 Hz do driver IIO assim que
	  houver 30 s de sinal. Exige o acesso IIO.

endchoice

endif

comment "monitor-news2 needs Qt6"
	depends on !BR2_PACKAGE_QT6
```
